## boards/shields/mitten/Kconfig.defconfig
```kconfig
if SHIELD_CRADIO_LEFT

config ZMK_KEYBOARD_NAME
    default "Mitten"

config ZMK_SPLIT_ROLE_CENTRAL
    default y

endif

if SHIELD_MITTEN_LEFT || SHIELD_MITTEN_RIGHT

config ZMK_SPLIT
    default y

endif
```

## boards/shields/mitten/Kconfig.shield
```kconfig
config SHIELD_MITTEN_LEFT
    def_bool $(shields_list_contains,mitten_left)

config SHIELD_MITTEN_RIGHT
    def_bool $(shields_list_contains,mitten_right)
```

## config/boards/shields/cradio2/Kconfig.shield
```kconfig
# Copyright (c) 2020 The ZMK Contributors
# SPDX-License-Identifier: MIT

config SHIELD_CRADIO2_LEFT
	def_bool $(shields_list_contains,cradio2_left)

config SHIELD_CRADIO2_RIGHT
	def_bool $(shields_list_contains,cradio2_right)
```

## config/boards/shields/mitten/Kconfig.defconfig
```kconfig
# Copyright (c) 2020 The ZMK Contributors
# SPDX-License-Identifier: MIT

if SHIELD_MITTEN_LEFT

config ZMK_KEYBOARD_NAME
	default "Mitten"

config ZMK_SPLIT_BLE_ROLE_CENTRAL
	default y

endif

if SHIELD_MITTEN_LEFT || SHIELD_MITTEN_RIGHT

config ZMK_SPLIT
	default y

endif

CONFIG_BUILD_OUTPUT_UF2=y
```

## config/boards/shields/mitten/Kconfig.shield
```kconfig
# Copyright (c) 2020 The ZMK Contributors
# SPDX-License-Identifier: MIT

config SHIELD_MITTEN_LEFT
	def_bool $(shields_list_contains,mitten_left)

config SHIELD_MITTEN_RIGHT
	def_bool $(shields_list_contains,mitten_right)
```
